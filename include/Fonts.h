#ifndef FONTS_H
#define FONTS_H

#include <Arduino.h>

// ============================================================================
// FONT 5x7 OPTIMIZED FOR P10 HUB12 (Running Text & Static Text)
// ============================================================================

const uint8_t Font5x7[][5] PROGMEM = {
    {0x3E, 0x51, 0x49, 0x45, 0x3E}, // 0 (idx 0)
    {0x00, 0x42, 0x7F, 0x40, 0x00}, // 1 (idx 1)
    {0x42, 0x61, 0x51, 0x49, 0x46}, // 2 (idx 2)
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    {0x08, 0x08, 0x08, 0x08, 0x08}, // - Minus Sign (idx 39)
    // Lowercase a-z (idx 40 - 65)
    {0x20, 0x54, 0x54, 0x54, 0x78}, // a (idx 40)
    {0x7F, 0x48, 0x44, 0x44, 0x38}, // b (idx 41)
    {0x38, 0x44, 0x44, 0x44, 0x20}, // c (idx 42)
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    {0x44, 0x64, 0x54, 0x4C, 0x44}, // z (idx 65)
};

inline int getGlyphIndex(char c) {
    if (c >= '0' && c <= '9') return c - '0';
    if (c == ':') return 10;
    if (c == '.') return 11;
    if (c == ' ') return 12;
    if (c >= 'A' && c <= 'Z') return 13 + (c - 'A');
    if (c >= 'a' && c <= 'z') return 40 + (c - 'a');
    if (c == '-') return 39;
    return 12; // default space
}

// ============================================================================
// ScaleFont16 (Font Rounded BOLD 14px Timbangan Digital - Full A-Z, 0-9)
// Seragam untuk Live Scale, Static Text, dan Running Text
// ============================================================================

const static uint8_t ScaleFont_0[] PROGMEM = {0xF8, 0x1F, 0xFC, 0x3F, 0xFE, 0x7F, 0x07, 0xE0, 0x07, 0xE0, 0x07, 0xE0, 0x07, 0xE0, 0x07, 0xE0, 0xFE, 0x7F, 0xFC, 0x3F, 0xF8, 0x1F}; // '0'
const static uint8_t ScaleFont_1[] PROGMEM = {0x04, 0xC0, 0x06, 0xC0, 0xFF, 0xFF, 0xFF, 0xFF, 0xFF, 0xFF, 0x00, 0xC0}; // '1'
const static uint8_t ScaleFont_2[] PROGMEM = {0x0C, 0xF0, 0x0E, 0xF8, 0x0F, 0xFC, 0x03, 0xEE, 0x03, 0xE7, 0x83, 0xE3, 0xC3, 0xE1, 0xE3, 0xE0, 0x7F, 0xE0, 0x3E, 0xE0, 0x1C, 0xE0}; // '2'
const static uint8_t ScaleFont_3[] PROGMEM = {0x0C, 0x10, 0x0E, 0x30, 0x0F, 0x70, 0x83, 0xE1, 0x83, 0xE1, 0x83, 0xE1, 0xC3, 0xE5, 0xE3, 0xE5, 0x7F, 0x7E, 0x3E, 0x3A, 0x1C, 0x1A}; // '3'
const static uint8_t ScaleFont_4[] PROGMEM = {0x80, 0x07, 0xC0, 0x07, 0xE0, 0x07, 0x70, 0x07, 0x38, 0x07, 0x1C, 0x07, 0x0E, 0x07, 0x07, 0x07, 0xFF, 0xFF, 0xFF, 0xFF, 0x00, 0x07}; // '4'
const static uint8_t ScaleFont_5[] PROGMEM = {0xFF, 0x10, 0xFF, 0x30, 0xFF, 0x70, 0x47, 0xE0, 0x27, 0xE0, 0x67, 0xE0, 0x67, 0xE0, 0x67, 0xE0, 0xE7, 0x7F, 0xC7, 0x3F, 0x87, 0x1F}; // '5'
const static uint8_t ScaleFont_6[] PROGMEM = {0xFC, 0x1F, 0xFE, 0x3F, 0xFF, 0x7F, 0x43, 0xE0, 0x23, 0xE0, 0x63, 0xE0, 0x63, 0xE0, 0x63, 0xE0, 0xE7, 0x7F, 0xC6, 0x3F, 0x84, 0x1F}; // '6'
const static uint8_t ScaleFont_7[] PROGMEM = {0x07, 0xE0, 0x07, 0xF8, 0x07, 0xFC, 0x07, 0x1F, 0x87, 0x07, 0xC7, 0x03, 0xE7, 0x00, 0x77, 0x00, 0x3F, 0x00, 0x1F, 0x00, 0x0F, 0x00}; // '7'
const static uint8_t ScaleFont_8[] PROGMEM = {0x1C, 0x1F, 0xBE, 0x3F, 0xFF, 0x7F, 0xE3, 0xE0, 0xE3, 0xE0, 0xE3, 0xE0, 0xE3, 0xE0, 0xE3, 0xE0, 0xFF, 0x7F, 0xBE, 0x3F, 0x1C, 0x1F}; // '8'
const static uint8_t ScaleFont_9[] PROGMEM = {0xFC, 0x20, 0xFE, 0x61, 0xFF, 0xE3, 0x03, 0xC3, 0x03, 0xC3, 0x03, 0xC3, 0x03, 0xC1, 0x83, 0xFF, 0xFF, 0x7F, 0xFE, 0x3F, 0xFC, 0x00}; // '9'
const static uint8_t ScaleFont_46[] PROGMEM = {0x00, 0xF0, 0x00, 0xF0, 0x00, 0xF0, 0x00, 0xF0}; // '.'
const static uint8_t ScaleFont_45[] PROGMEM = {0x80, 0x01, 0x80, 0x01, 0x80, 0x01, 0x80, 0x01, 0x80, 0x01, 0x80, 0x01, 0x80, 0x01}; // '-'
const static uint8_t ScaleFont_58[] PROGMEM = {0x1C, 0x0E, 0x1C, 0x0E, 0x1C, 0x0E, 0x1C, 0x0E}; // ':'
const static uint8_t ScaleFont_32[] PROGMEM = {0x00, 0x00, 0x00, 0x00, 0x00, 0x00, 0x00, 0x00}; // ' '
const static uint8_t ScaleFont_Char_A[] PROGMEM = {0xF8, 0x7F, 0xFC, 0x7F, 0xC6, 0x00, 0xC6, 0x00, 0xC6, 0x00, 0xFC, 0x7F, 0xF8, 0x7F}; // 'A'
const static uint8_t ScaleFont_Char_B[] PROGMEM = {0xFE, 0x7F, 0xFE, 0x7F, 0xE6, 0x60, 0xE6, 0x60, 0xE6, 0x60, 0xFE, 0x7F, 0xDC, 0x3F}; // 'B'
const static uint8_t ScaleFont_Char_C[] PROGMEM = {0xFC, 0x3F, 0xFE, 0x7F, 0x06, 0x60, 0x06, 0x60, 0x06, 0x60, 0x0E, 0x70, 0x0C, 0x30}; // 'C'
const static uint8_t ScaleFont_Char_D[] PROGMEM = {0xFE, 0x7F, 0xFE, 0x7F, 0x06, 0x60, 0x06, 0x60, 0x06, 0x60, 0xFE, 0x7F, 0xFC, 0x3F}; // 'D'
const static uint8_t ScaleFont_Char_E[] PROGMEM = {0xFE, 0x7F, 0xFE, 0x7F, 0xE6, 0x60, 0xE6, 0x60, 0xE6, 0x60, 0xE6, 0x60, 0x06, 0x60}; // 'E'
const static uint8_t ScaleFont_Char_F[] PROGMEM = {0xFE, 0x7F, 0xFE, 0x7F, 0xE6, 0x00, 0xE6, 0x00, 0xE6, 0x00, 0xE6, 0x00, 0x06, 0x00}; // 'F'
const static uint8_t ScaleFont_Char_G[] PROGMEM = {0xFC, 0x3F, 0xFE, 0x7F, 0x06, 0x60, 0x86, 0x61, 0x86, 0x61, 0x8E, 0x7F, 0x8C, 0x3F}; // 'G'
const static uint8_t ScaleFont_Char_H[] PROGMEM = {0xFE, 0x7F, 0xFE, 0x7F, 0xE0, 0x00, 0xE0, 0x00, 0xE0, 0x00, 0xFE, 0x7F, 0xFE, 0x7F}; // 'H'
const static uint8_t ScaleFont_Char_I[] PROGMEM = {0x06, 0x60, 0xFE, 0x7F, 0xFE, 0x7F, 0x06, 0x60}; // 'I'
const static uint8_t ScaleFont_Char_J[] PROGMEM = {0x00, 0x38, 0x00, 0x78, 0x00, 0x60, 0x00, 0x60, 0x00, 0x60, 0xFE, 0x7F, 0xFE, 0x3F}; // 'J'
const static uint8_t ScaleFont_Char_K[] PROGMEM = {0xFE, 0x7F, 0xFE, 0x7F, 0x70, 0x00, 0xF8, 0x00, 0xCC, 0x01, 0x86, 0x7F, 0x82, 0x7F}; // 'K'
const static uint8_t ScaleFont_Char_L[] PROGMEM = {0xFE, 0x7F, 0xFE, 0x7F, 0x00, 0x60, 0x00, 0x60, 0x00, 0x60, 0x00, 0x60, 0x00, 0x60}; // 'L'
const static uint8_t ScaleFont_Char_M[] PROGMEM = {0xFE, 0x7F, 0xFE, 0x7F, 0x3C, 0x00, 0x78, 0x00, 0x3C, 0x00, 0xFE, 0x7F, 0xFE, 0x7F}; // 'M'
const static uint8_t ScaleFont_Char_N[] PROGMEM = {0xFE, 0x7F, 0xFE, 0x7F, 0x3C, 0x00, 0x78, 0x00, 0xF0, 0x00, 0xFE, 0x7F, 0xFE, 0x7F}; // 'N'
const static uint8_t ScaleFont_Char_O[] PROGMEM = {0xFC, 0x3F, 0xFE, 0x7F, 0x06, 0x60, 0x06, 0x60, 0x06, 0x60, 0xFE, 0x7F, 0xFC, 0x3F}; // 'O'
const static uint8_t ScaleFont_Char_P[] PROGMEM = {0xFE, 0x7F, 0xFE, 0x7F, 0xC6, 0x00, 0xC6, 0x00, 0xC6, 0x00, 0xFE, 0x00, 0x7C, 0x00}; // 'P'
const static uint8_t ScaleFont_Char_Q[] PROGMEM = {0xFC, 0x1F, 0xFE, 0x3F, 0x06, 0x30, 0x06, 0x38, 0x06, 0x38, 0xFE, 0x7F, 0xFC, 0x7F}; // 'Q'
const static uint8_t ScaleFont_Char_R[] PROGMEM = {0xFE, 0x7F, 0xFE, 0x7F, 0xE6, 0x00, 0xE6, 0x01, 0xE6, 0x07, 0x7E, 0x7E, 0x5C, 0x78}; // 'R'
const static uint8_t ScaleFont_Char_S[] PROGMEM = {0x3C, 0x38, 0x7E, 0x78, 0xE6, 0x60, 0xE6, 0x60, 0xE6, 0x60, 0xEE, 0x7F, 0xCC, 0x3F}; // 'S'
const static uint8_t ScaleFont_Char_T[] PROGMEM = {0x06, 0x00, 0x06, 0x00, 0xFE, 0x7F, 0xFE, 0x7F, 0x06, 0x00, 0x06, 0x00, 0x06, 0x00}; // 'T'
const static uint8_t ScaleFont_Char_U[] PROGMEM = {0xFE, 0x3F, 0xFE, 0x7F, 0x00, 0x60, 0x00, 0x60, 0x00, 0x60, 0xFE, 0x7F, 0xFE, 0x3F}; // 'U'
const static uint8_t ScaleFont_Char_V[] PROGMEM = {0x7E, 0x00, 0xFE, 0x03, 0x80, 0x1F, 0x00, 0x7C, 0x80, 0x1F, 0xFE, 0x03, 0x7E, 0x00}; // 'V'
const static uint8_t ScaleFont_Char_W[] PROGMEM = {0xFE, 0x7F, 0xFE, 0x7F, 0x00, 0x1E, 0x00, 0x0F, 0x00, 0x1E, 0xFE, 0x7F, 0xFE, 0x7F}; // 'W'
const static uint8_t ScaleFont_Char_X[] PROGMEM = {0x06, 0x78, 0x1E, 0x7E, 0xB8, 0x07, 0xE0, 0x01, 0xB8, 0x07, 0x1E, 0x7E, 0x06, 0x78}; // 'X'
const static uint8_t ScaleFont_Char_Y[] PROGMEM = {0x0E, 0x00, 0x3E, 0x00, 0x70, 0x00, 0xC0, 0x7F, 0x70, 0x00, 0x3E, 0x00, 0x0E, 0x00}; // 'Y'
const static uint8_t ScaleFont_Char_Z[] PROGMEM = {0x06, 0x7C, 0x06, 0x7F, 0xC6, 0x63, 0xE6, 0x60, 0x36, 0x60, 0x1E, 0x60, 0x0E, 0x60}; // 'Z'
 
inline uint8_t getScaleFontWidth(char c) {
    if (c >= 'a' && c <= 'z') c = c - 'a' + 'A';
    switch (c) {
        case '0': case '2': case '3': case '4': case '5': case '6': case '7': case '8': case '9': return 11;
        case '1': return 6;
        case '.': return 4;
        case '-': return 7;
        case ':': return 4;
        case ' ': return 4;
        case 'A': case 'B': case 'C': case 'D': case 'E': case 'F': case 'G': case 'H': return 7;
        case 'I': return 4;
        case 'J': return 7;
        case 'K': return 7;
        case 'L': case 'M': case 'N': case 'O': case 'P': case 'Q': case 'R': case 'S': case 'T': case 'U': case 'V': case 'W': case 'X': case 'Y': case 'Z': return 7;
        default: return 0;
    }
}

inline const uint8_t* getScaleFontData(char c) {
    if (c >= 'a' && c <= 'z') c = c - 'a' + 'A';
    switch (c) {
        case '0': return ScaleFont_0;
        case '1': return ScaleFont_1;
        case '2': return ScaleFont_2;
        case '3': return ScaleFont_3;
        case '4': return ScaleFont_4;
        case '5': return ScaleFont_5;
        case '6': return ScaleFont_6;
        case '7': return ScaleFont_7;
        case '8': return ScaleFont_8;
        case '9': return ScaleFont_9;
        case '.': return ScaleFont_46;
        case '-': return ScaleFont_45;
        case ':': return ScaleFont_58;
        case ' ': return ScaleFont_32;
        case 'A': return ScaleFont_Char_A;
        case 'B': return ScaleFont_Char_B;
        case 'C': return ScaleFont_Char_C;
        case 'D': return ScaleFont_Char_D;
        case 'E': return ScaleFont_Char_E;
        case 'F': return ScaleFont_Char_F;
        case 'G': return ScaleFont_Char_G;
        case 'H': return ScaleFont_Char_H;
        case 'I': return ScaleFont_Char_I;
        case 'J': return ScaleFont_Char_J;
        case 'K': return ScaleFont_Char_K;
        case 'L': return ScaleFont_Char_L;
        case 'M': return ScaleFont_Char_M;
        case 'N': return ScaleFont_Char_N;
        case 'O': return ScaleFont_Char_O;
        case 'P': return ScaleFont_Char_P;
        case 'Q': return ScaleFont_Char_Q;
        case 'R': return ScaleFont_Char_R;
        case 'S': return ScaleFont_Char_S;
        case 'T': return ScaleFont_Char_T;
        case 'U': return ScaleFont_Char_U;
        case 'V': return ScaleFont_Char_V;
        case 'W': return ScaleFont_Char_W;
        case 'X': return ScaleFont_Char_X;
        case 'Y': return ScaleFont_Char_Y;
        case 'Z': return ScaleFont_Char_Z;
        default: return nullptr;
    }
}

#endif // FONTS_H
